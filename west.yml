## west.yml
```yaml
# Copyright (c) 2021 Nordic Semiconductor ASA
# SPDX-License-Identifier: Apache-2.0

manifest:
  self:
    path: sample_app

  remotes:
    - name: zephyrproject-rtos
      url-base: https://github.com/zephyrproject-rtos
    - name: gitlab100
      url-base: git@10.1.20.100:embedded

  projects:
    - name: zephyr
      remote: zephyrproject-rtos
      revision: v3.1-branch
      import: true
    - name: boards
      remote: gitlab100
      path: sample_app/hc_modules/boards
      revision: main
```
